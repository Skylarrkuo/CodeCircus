;************************************************************************
;请把下一行注释中的XXX、YYYYYY改成你的姓名和学号
;姓名:XXX, 学号:YYYYYY
;【顺序结构程序设计】本题共20分
;假设x、y、z 均为8字节带符号整数，依次存放在地址为X, X+2, X+4,X+6； Y, Y+2, 
;Y+4, Y+6 ；Z, Z+2, Z+4, Z+6的字存储单元中，存放时高位字在高地址，
;低位字在低地址。编程序计算w = x + y + 24 - z,  并用W, W+2, W+4, W+6
;字单元存放结果w（不考虑数据溢出问题）。处理完毕显示'OK!'信息。
;要求源程序中包含完善的注释信息。做题时不要损坏题中原有的注释线。
;****************************评分标准***********************************
;（1）有完善的注释信息2分；
;（2）变量定义正确2分；
;(3)计算出x+Y 得3分,计算出x + y + 24 得3分,计算出x + y + 24 -Z 得3分,
;把结果保到W得3分;
;(4)指令无语法错误，能编译成EXE文件4分。
;************************************************************************
DATAS SEGMENT
	X	DW 1122,3344,5566,7788
	Y 	DW 2233,4455,6677,8899
	Z	DW 1234,5678,4321,8765
;-------------------------所需变量定义于两横线之间-------------------
	W	DW 4 DUP(?)
	OK	DB 'OK!',0dh,0ah,'$'
;------------------------------------------------------------------------
DATAS ENDS

CODES SEGMENT
    ASSUME CS:CODES,DS:DATAS,ES:DATAS
START:
    MOV AX,DATAS
    MOV DS,AX
    MOV ES,AX
;--------------------------程序代码写于两横线之间---------------------
	MOV  AX,  X
	MOV  BX,  X[2]   
	MOV  CX,  X[4]
	MOV	 DX,  X[6]
	 
	ADD  AX,  Y  
	ADC  BX,  Y[2]
	ADC  CX,  Y[4]
	ADC  DX,  Y[6]
	  
	ADD  AX,  24  
	ADC  BX,  0
	ADC  CX,  0
	ADC  DX,  0
	 
	SUB  AX,  Z   
	SBB  BX,  Z[2]
	SBB  CX,  Z[4]
	SBB  DX,  Z[6]
	  
	MOV  W,   AX  
	MOV  W[2], BX
	MOV  W[4], CX
	MOV  W[6], DX 
;--------------------------------------------------------------------------
;其它处理（代码略） 
	MOV AH,9
	MOV DX, OFFSET Ok
	INT 21H
    MOV AX,4C00H
    INT 21H
CODES ENDS
    END START
;************************************************************************
;请把下一行注释中的XXX、YYYYYY改成你的姓名和学号
;姓名:XXX, 学号:YYYYYY
;【顺序结构程序设计】本题共20分
;假设x、y、r、w均为16位带符号整数，分别保存于字单元X、Y、R和W字存储
;单元。编写程序计算(w + x*y + 230)/(r-80)/2。 表达式计算结果存于
;字单元Z中(忽略余数)。假设(r-80)不会超出16位带符号数表示范围，
;整个表达式结果不会超出16位符号数表示范围。处理完毕显示'OK!'信息。
;要求源程序中包含完善的注释信息。做题时不要损坏题中原有的注释线。
;****************************评分标准***********************************
;（1）有完善的注释信息2分；
;（2）变量定义正确2分；
;(3)计算出(w + x*y + 230)得3分,计算出(w + x*y + 230)/(r-80)/2得3分,
;正确地显示'OK!'信息得3分，正确地保存结果得3分;
;(4)指令无语法错误，能编译成EXE文件4分。
;************************************************************************
DATAS SEGMENT
	X	DW 22
	Y 	DW 2233
	R	DW 180
	W	DW 8765
;-------------------------所需变量定义于两横线之间-------------------
	OK	DB 'OK!',0dh,0ah,'$'
	Z	DW ?
;------------------------------------------------------------------------
DATAS ENDS

CODES SEGMENT
    ASSUME CS:CODES,DS:DATAS,ES:DATAS
START:
    MOV AX,DATAS
    MOV DS,AX
    MOV ES,AX
;--------------------------程序代码写于两横线之间---------------------
	MOV AX, X
	IMUL Y
	ADD AX, W
	ADC DX, 0
	ADD AX, 230
	ADC DX, 0
	MOV BX, R
	SUB BX, 80
	IDIV BX
	SAR AX,1
	MOV Z,AX
	MOV AH,9
	MOV DX, OFFSET Ok
	INT 21H	
;--------------------------------------------------------------------------
;其它处理（代码略） 
    MOV AX,4C00H
    INT 21H
CODES ENDS
    END START